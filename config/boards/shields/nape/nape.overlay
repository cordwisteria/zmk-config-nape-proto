/ {
    chosen {
        zmk,kscan = &default_kscan;
    };

    default_kscan: kscan {
        compatible = "zmk,kscan-gpio-direct";
        label = "default_kscan";

        input-gpios =
            <&xiao_d 10 (GPIO_PULL_UP | GPIO_ACTIVE_LOW)>,
            <&xiao_d 9 (GPIO_PULL_UP | GPIO_ACTIVE_LOW)>,
            <&xiao_d 8 (GPIO_PULL_UP | GPIO_ACTIVE_LOW)>,
            <&xiao_d 1 (GPIO_PULL_UP | GPIO_ACTIVE_LOW)>,
            <&xiao_d 2 (GPIO_PULL_UP | GPIO_ACTIVE_LOW)>,
            <&xiao_d 3 (GPIO_PULL_UP | GPIO_ACTIVE_LOW)>
            ;
    };
};