## config/boards/shields/nape/Kconfig.defconfig
```kconfig
if NAPE
config ZMK_KEYBOARD_NAME
    default "Nape Trackball"

# デフォルト向きレイヤーの設定
config NAPE_DEFAULT_LAYER
    int "電源オン時のデフォルトの向きレイヤー"
    default 3
    range 0 3
    help
      電源オン時のデフォルトの使用向きを選択。
      0: USBポートが下 
      1: USBポートが左 
      2: USBポートが上 
      3: USBポートが右
endif
```

## config/west.yml
```yaml
manifest:
  remotes:
    - name: zmkfirmware
      url-base: https://github.com/zmkfirmware
    - name: cordwisteria
      url-base: https://github.com/cordwisteria
    # Additional modules containing boards/shields/custom code can be listed here as well
    # See https://docs.zephyrproject.org/3.2.0/develop/west/manifest.html#projects
  projects:
    - name: zmk
      remote: zmkfirmware
      revision: main
      import: app/west.yml
    - name: zmk-pmw3610-driver
      remote: cordwisteria
      revision: feat/runtime-orientation
  self:
    path: config
```
